## configs/cmos_rv1126_rv1109_sf100_defconfig
```kconfig
#include "base.config"
#include "base_extra.config"
#include "debug.config"
#include "audio.config"
#include "wifi.config"
#include "network.config"
#include "bt.config"
#include "video_mpp.config"
#include "rv1126_rv1109_arm.config"
#include "camera.config"
#include "updateEngine.config"

BR2_ROOTFS_OVERLAY="board/rockchip/rv1126_rv1109/fs-overlay-sysv/"
BR2_PACKAGE_RKWIFIBT_RTL8822ES=y
BR2_PACKAGE_RKWIFIBT_BTUART="ttyS0"

BR2_PACKAGE_RK_OEM=y
BR2_PACKAGE_RK_OEM_RESOURCE_DIR="$(TOPDIR)/../device/rockchip/oem/oem_ipc_cmos"

BR2_PACKAGE_PCBA_ADB_TEST=y
BR2_PACKAGE_USB_SERIAL=y
BR2_PACKAGE_DBUS_GLIB=y

BR2_PACKAGE_JASPER=y
BR2_PACKAGE_OPENCV3=y
BR2_PACKAGE_OPENCV3_LIB_CALIB3D=y
BR2_PACKAGE_OPENCV3_LIB_HIGHGUI=y
BR2_PACKAGE_OPENCV3_WITH_JPEG=y
BR2_PACKAGE_OPENCV3_WITH_PNG=y

BR2_PACKAGE_TIFF=y

BR2_PACKAGE_AVAHI=y
BR2_PACKAGE_AVAHI_DAEMON=y
BR2_PACKAGE_AVAHI_LIBDNSSD_COMPATIBILITY=y
BR2_PACKAGE_CONNMAN=y
BR2_PACKAGE_CONNMAN_WIFI=y
BR2_PACKAGE_CONNMAN_LOOPBACK=y
BR2_PACKAGE_CONNMAN_CLIENT=y
BR2_PACKAGE_CRDA=y

BR2_PACKAGE_WPA_SUPPLICANT_DEBUG_SYSLOG=y
BR2_PACKAGE_UTIL_LINUX_RFKILL=y

# dcmedia 
BR2_PACKAGE_MPP=y
BR2_PACKAGE_MPP_ALLOCATOR_DRM=y
BR2_PACKAGE_ALSA_LIB=y
BR2_PACKAGE_LINUX_RGA=y
BR2_PACKAGE_RKNPU=y
BR2_PACKAGE_RKNPU_USE_RKNN_API=y
BR2_PACKAGE_ROCKX=y
BR2_PACKAGE_LIBDRM=y
BR2_PACKAGE_LIVE555=y
BR2_PACKAGE_MINILOGGER=y
BR2_PACKAGE_COMMON_ALGORITHM=y
BR2_PACKAGE_COMMON_ALGORITHM_ANR=y
BR2_PACKAGE_COMMON_ALGORITHM_AEC_ANR_AGC=y
BR2_PACKAGE_COMMON_ALGORITHM_MOVE_DETECT=y
BR2_PACKAGE_COMMON_ALGORITHM_OCCLUSION_DETECT=y

BR2_PACKAGE_DCMEDIA=y
BR2_PACKAGE_DC100_TEST=y
BR2_PACKAGE_THERMAL_CAMERA=y
BR2_PACKAGE_TOF_SENSOR=y
BR2_PACKAGE_JSON_C=y

BR2_PACKAGE_EIGEN=y

BR2_PACKAGE_FFMPEG_ENCODERS="mp2 adpcm_g726 pcm_alaw pcm_mulaw rawvideo mjpeg mpeg2video aac h264"
BR2_PACKAGE_FFMPEG_DECODERS="pcm_alaw pcm_mulaw rawvideo mjpeg mpeg2video aac h264"
BR2_PACKAGE_FFMPEG_MUXERS="pcm_alaw pcm_mulaw g722 g726 adts rawvideo mjpeg mp4 mov rtp flv f4v mpegts matroska avi rtsp mpeg1system h264"
BR2_PACKAGE_FFMPEG_DEMUXERS="pcm_alaw pcm_mulaw g722 g726 rawvideo mpegts mov flv matroska avi rtsp h264"
BR2_PACKAGE_FFMPEG_PARSERS="aac h264"
BR2_PACKAGE_FFMPEG_BSFS="aac_adtstoasc h264_metadata h264_mp4toannexb h264_redundant_pps hevc_metadata hevc_mp4toannexb dump_extradata remove_extradata"
BR2_PACKAGE_FFMPEG_PROTOCOLS="file rtp srtp rtmp rtmps http https"
BR2_PACKAGE_FFMPEG_FILTERS="scale"
BR2_TARGET_GENERIC_ROOT_PASSWD="cmos"
```

## package/rockchip/camera_engine_dcaiq/Config.in
```kconfig
menuconfig BR2_PACKAGE_CAMERA_ENGINE_DCAIQ
	bool "DC100 Camera Engine Dcaiq for SoC with ISP2"
	help
	  Rockchip camera engine rkaiq for linux.
```

## package/rockchip/dc100_test/Config.in
```kconfig
config BR2_PACKAGE_DC100_TEST
    bool "dc100_test"
    depends on BR2_PACKAGE_DCMEDIA
    depends on BR2_PACKAGE_CAMERA_ENGINE_DCAIQ

    help
    This is a cmosmediatech DC100 board test code pakage.
```

## package/rockchip/dcmedia/Config.in
```kconfig
config BR2_PACKAGE_DCMEDIA
    bool "dcmedia"
    depends on BR2_PACKAGE_MPP
    depends on BR2_PACKAGE_MPP_ALLOCATOR_DRM
    depends on BR2_PACKAGE_ALSA_LIB
    depends on BR2_PACKAGE_LINUX_RGA
    depends on BR2_PACKAGE_RKNPU
    depends on BR2_PACKAGE_RKNPU_USE_RKNN_API
    depends on BR2_PACKAGE_COMMON_ALGORITHM
    depends on BR2_PACKAGE_COMMON_ALGORITHM_ANR
    depends on BR2_PACKAGE_COMMON_ALGORITHM_AEC_ANR_AGC  
    depends on BR2_PACKAGE_COMMON_ALGORITHM_MOVE_DETECT
    depends on BR2_PACKAGE_COMMON_ALGORITHM_OCCLUSION_DETECT
    depends on BR2_PACKAGE_ROCKX
    depends on BR2_PACKAGE_LIBDRM
    depends on BR2_PACKAGE_LIVE555
    depends on BR2_PACKAGE_MINILOGGER
    help
    This is a cmosmediatech DC100 media library pakage.

    
```

## package/rockchip/thermal_camera/Config.in
```kconfig
config BR2_PACKAGE_THERMAL_CAMERA
    bool "thermal_camera"
    help
    This is a DC100 thermal camera library pakage.

    
```

## package/rockchip/tof_sensor/Config.in
```kconfig
config BR2_PACKAGE_TOF_SENSOR
    bool "tof_sensor"
    help
    This is a DC100 tof sensor library pakage.

    
```

## package/rockchip/usb_serial/Config.in
```kconfig
config BR2_PACKAGE_USB_SERIAL
    bool "usb_serial"
    help
    inatall usbserial.ko
```
